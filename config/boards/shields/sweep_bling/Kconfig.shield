## config/boards/shields/sweep_bling/Kconfig.shield
```kconfig
config SHIELD_SWEEP_BLING_LEFT
    def_bool $(shields_list_contains,sweep_bling_left)

config SHIELD_SWEEP_BLING_RIGHT
    def_bool $(shields_list_contains,sweep_bling_right)
```

## config/drivers/zmk-ps2-driver/dts/bindings/ps2/pio-ps2.yaml
```yaml
# Copyright (c) 2023 GitHub Copilot
# SPDX-License-Identifier: Apache-2.0

description: RP2040 PIO PS/2 driver

compatible: "pio-ps2"

include: base.yaml

properties:
    scl-gpios:
      type: phandle-array
      required: true
      description: GPIO to which the SCL (Clock) pin is connected.
    sda-gpios:
      type: phandle-array
      required: true
      description: GPIO to which the SDA (Data) pin is connected.
```

## config/drivers/zmk-ps2-driver/dts/bindings/zmk,input-mouse-ps2.yaml
```yaml
description: PS/2 mouse configuration

compatible: "zmk,input-mouse-ps2"

include: base.yaml

properties:
  ps2-device:
    type: phandle
    required: true
    description: The ps2 device the mouse should use.

  rst-gpios:
    type: phandle-array
    required: false
    description: GPIO for Power-On-Reset.

  sampling-rate:
    type: int
    description: Allowed values are 10, 20, 40, 60, 80, 100, 200.
    enum: [10, 20, 40, 60, 80, 100, 200]

  scroll-mode:
    type: boolean
  
  disable-clicking:
    type: boolean

  tp-press-to-select:
    type: boolean

  tp-press-to-select-threshold:
    type: int

  tp-sensitivity:
    type: int

  tp-neg-inertia:
    type: int

  tp-val6-upper-speed:
    type: int

  tp-x-invert:
    type: boolean

  tp-y-invert:
    type: boolean

  tp-xy-swap:
    type: boolean

  layer-toggle:
    type: int
    required: false
```

## config/drivers/zmk-ps2-driver/src/drivers/ps2/Kconfig
```kconfig
# Copyright (c) 2023 The ZMK Contributors
# SPDX-License-Identifier: MIT

if PS2

rsource "Kconfig.gpio"
rsource "Kconfig.uart"
rsource "Kconfig.pio"

endif # PS2
```

## config/drivers/zmk-ps2-driver/src/drivers/ps2/Kconfig.pio
```kconfig
# Copyright (c) 2023 GitHub Copilot
# SPDX-License-Identifier: Apache-2.0

DT_COMPAT_PS2_PIO := pio-ps2

config PS2_PIO
	bool "RP2040 PIO-based PS/2 support"
	depends on SOC_RP2040
	help
	  Enable hardware-accelerated PS/2 support using RP2040 PIO state machines.
	  This driver offloads timing-critical PS/2 frame decoding to the PIO,
	  reducing CPU load and improving reliability compared to GPIO bit-banging.

if PS2_PIO

config PS2_PIO_ENABLE_PS2_RESEND_CALLBACK
	bool "Notify the PS2 device driver (mouse driver) when the received data is invalid and a resend is requested from the peripheral. This can help the higher level PS2 device driver handle transmission errors with less side-effects."
	default n
	select ZMK_INPUT_MOUSE_PS2_ENABLE_PS2_RESEND_CALLBACK

# PS/2 events must be processed within 30-50us. Therefore we shift the
# BT_CTLR_LLL_PRIO from 0 to 1 and BT_CTLR_ULL_* priorities from 1 to 2.
# We then set the PIO interrupt priority to 0 (highest).
config BT_CTLR_ADVANCED_FEATURES
	default y

config BT_CTLR_LLL_PRIO
	default 1

config BT_CTLR_ULL_HIGH_PRIO
	default 2

config BT_CTLR_ULL_LOW_PRIO
	default 2

config PS2_PIO_INTERRUPT_LOG_ENABLED
	bool "Enable extensive PIO interrupt logging."
	default n

endif # PS2_PIO
```
