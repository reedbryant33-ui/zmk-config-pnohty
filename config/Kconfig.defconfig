## config/dts/bindings/zmk,input-mouse-ps2.yaml
```yaml
description: ZMK PS/2 Mouse Input Driver

compatible: "zmk,input-mouse-ps2"

include: base.yaml

properties:
  ps2-device:
    type: phandle
    required: true
    description: The PS/2 driver device
```

## config/west.yml
```yaml
manifest:
  remotes:
    - name: zmkfirmware
      url-base: https://github.com/zmkfirmware
    - name: petejohanson
      url-base: https://github.com/petejohanson
    - name: infused-kim
      url-base: https://github.com/infused-kim
  projects:
    - name: zmk
      remote: petejohanson
      revision: feat/pointers-move-scroll # This is the "God Tier" mouse branch
      import: app/west.yml
    - name: kb_zmk_ps2_mouse_trackpoint_driver
      remote: infused-kim
      revision: main
      path: modules/drivers/ps2
  self:
    path: config
```

## modules/drivers/ps2/Kconfig
```kconfig
config ZMK_INPUT_MOUSE_PS2
    bool "PS/2 mouse"
    default y if DT_HAS_ZMK_INPUT_MOUSE_PS2_ENABLED
    select ZMK_MOUSE
    select PS2

config PS2_PIO
    bool "PS/2 PIO driver"
    default y if DT_HAS_GPIO_PS2_PIO_ENABLED
    select PS2
    select HAS_DTS_GPIO
    help
      Enable PS/2 driver using RP2040 PIO (Programmable I/O).
      This approach uses the PIO state machines for deterministic
      timing instead of CPU-driven GPIO interrupts.

config PS2_PIO_INIT_PRIORITY
    int "PS/2 PIO init priority"
    default 45
    depends on PS2_PIO
    help
      Initialization priority for the PS/2 PIO driver.
```

## modules/drivers/ps2/dts/bindings/ps2_pio.yaml
```yaml
description: GPIO PS/2 PIO driver for RP2040

compatible: "gpio-ps2-pio"

include: base.yaml

properties:
  scl-gpios:
    type: phandle-array
    required: true
    description: GPIO pin used for PS/2 Clock (SCL)

  sda-gpios:
    type: phandle-array
    required: true
    description: GPIO pin used for PS/2 Data (SDA)

  pio-device:
    type: phandle
    required: true
    description: Reference to the PIO device (pio0 or pio1)

  pio-sm:
    type: int
    required: true
    description: PIO state machine index (0-3)
```

## modules/drivers/ps2/zephyr/Kconfig
```kconfig
# Source parent Kconfig to get ZMK_INPUT_MOUSE_PS2 definition
rsource "../Kconfig"

# For PS/2 PIO variant selection

if PS2

config PS2_PIO
    bool "PS/2 GPIO PIO bit-banging driver (RP2040)"
    select HAS_DTS_GPIO
    help
      Enable PS/2 driver using RP2040 PIO (Programmable I/O).
      This approach uses the PIO state machines for deterministic
      timing instead of CPU-driven GPIO interrupts.
      
config PS2_PIO_INIT_PRIORITY
    int "PS/2 PIO driver initialization priority"
    default 45
    depends on PS2_PIO

endif # PS2
```
